## main/Kconfig.projbuild
```kconfig
menu "App Configuration"

config APP_TARGET_HOST
    string "Target host"
    default "raspberrypi.local"
    help
        host address to connect

config APP_TARGET_PORT
    int "Target port"
    default 55555
    help
        host port to connect

choice APP_SCENARIO
	prompt "Test scenario"
	default APP_SCENARIO_CLASSIC_FASTEST

config APP_SCENARIO_CLASSIC_FASTEST
    bool "Classic fastest"

config APP_SCENARIO_PQC_FASTEST
    bool "PQC fastest"

config APP_SCENARIO_REC_XU
    bool "Recommended XU"

config APP_SCENARIO_ONLY_NIST
    bool "Only NIST"

config APP_SCENARIO_SPHICS_ACC
    bool "SPHINCS+ accelerated"

config APP_SCENARIO_RSA_ACC
    bool "RSA accelerated"

endchoice

config APP_WIFI_MAXIMUM_RETRY
	int "Retry number"
	default 5
config APP_WIFI_SSID
	string "Name of the AP"
config APP_WIFI_PASS
	string "Password to AP"

endmenu
```
